#include "Hardware/hc_sr04.h"
#include "SYSTEM/delay.h"

// ============================================================
// HC-SR04 超声波测距驱动
//
// 工作原理：
//   1. TRIG 发 ≥10μs 高脉冲 → 模块发射 8 个 40kHz 方波
//   2. ECHO 变高 → 模块正在测距
//   3. ECHO 变低 → 测距完成
//   4. ECHO 高电平时间 ∝ 距离 (声速 340m/s 下 ≈58μs/cm)
//
// 测量流程：
//   1. 主循环每轮调用 SR04_Poll()，内部每 ~20ms 测一次
//   2. TRIG 发 20μs 脉冲 → 等 ECHO 上升沿 → 等 ECHO 下降沿
//   3. 读取 Timer0 计数值 → 换算为 mm → 喂入滑动窗口
//   4. SR04_GetFiltered() 返回 3 次平均 (去噪/去毛刺)
//
// ⚠️ 阻塞警告：
//   本驱动的 Poll 函数最长可阻塞约 25ms (ECHO 最大脉宽
//   对应 ~4.3m 距离)。在此期间：
//     - 所有按键响应丢失
//     - 红外遥控不响应
//     - LCD 不刷新
//   如果需要更快的响应速度，应改为异步状态机实现。
//
//   实际影响评估：
//     主循环约 10ms 一轮，每 2 轮测一次 (20ms)。
//     室内测距一般 ≤50cm → ECHO 脉宽 ≤2.9ms → 阻塞可接受。
//     只在障碍物极远 (>4m) 时有明显卡顿。
// ============================================================

// ---------- Timer1 溢出标志 (ISR 置位, 主循环读取) ----------
bit  sr04_timeout = 0;

// ---------- 内部状态 ----------
static u8   tick    = 0;     // 主循环轮次计数器 (控制采样间隔)
static u16  raw_mm  = 0;     // 最近一次测量值 (mm)

// ---------- 滑动平均缓冲区 ----------
static idata u16 buf[SR04_WIN_SIZE];  // 最近 SR04_WIN_SIZE 次原始测量值 (放 idata 节省 DATA)
static u8   idx  = 0;            // 环形缓冲区写入指针
static u8   fill = 0;            // 缓冲区已填充数量 (0→SR04_WIN_SIZE)

// ============================================================
// SR04_Init — 初始化引脚和 Timer1
//
// 引脚：
//   SR04_TRIG = P2^1 → 输出 (发触发脉冲)
//   SR04_ECHO = P2^0 → 输入 (准双向口写1=高阻输入模式)
//
// Timer0：
//   模式1 (16位定时器), 不自动重装
//   最大 65535 ticks × 1.085μs = 71ms ≈ 12m 测距上限
//   使用溢出中断做超时保护（Echo 高电平 >71ms → 异常）
// ============================================================
void SR04_Init(void)
{
    SR04_TRIG = 0;         // TRIG 初始低电平
    SR04_ECHO = 1;         // 准双向口：写 1 使其能读引脚

    // Timer0 模式1 (16位), 暂不启动
    TMOD &= 0xF0;          // 清 Timer0 字段 (bit0~3)
    TMOD |= 0x01;          // 模式1: 16位, 需手动重装
    TH0 = 0;
    TL0 = 0;
    ET0 = 1;               // 允许溢出中断 → sr04_timeout=1
    TR0 = 0;               // 先不跑，等 Echo 变高时才启动

    sr04_timeout = 0;
    raw_mm  = 0;
    tick    = 0;
    idx     = 0;
    fill    = 0;
}

// ============================================================
// SR04_Poll — 主循环每轮调一次 (约每 10ms)
//
// 测距时序 (在一次 Poll 中完整执行，不跨次)：
//
//   TRIG:   ──────╮    ╭──╮    ╭─────────
//                 ╰────╯  ╰────╯
//                  >20μs脉冲
//
//   ECHO:   ──────╮               ╭──────
//                  ╰───────────────╯
//                  8×40kHz发射  回波到达
//                  ├── 脉宽 ∝ 距离 ──┤
//
//   Timer0:        不跑        计数中
//                  ├── 等上升沿 ─┤├─ 等下降沿 ─┤  (阻塞)
//
// ⚠️ "放电" 操作说明：
//   在某些廉价 HC-SR04 模块上，ECHO 引脚可能在一次测量后
//   残留中间电平。把 ECHO 短暂拉低再拉高可以复位模块的
//   输出级。但 ECHO 是模块的输出引脚，在 8051 准双向口上
//   写 0 相当于强下拉，可能与模块输出发生短暂冲突。
//   如果模块发热异常，可删除下面三行。
// ============================================================
void SR04_Poll(void)
{
    u16 ticks;
    u16 fast_wait;

    // ---------- 间隔控制 ----------
    // 每 SR04_TICK_PERIOD 轮 (≈20ms) 才测一次
    // HC-SR04 推荐最小测量间隔 60ms，这里取 20ms 以提高刷新率
    tick++;
    if (tick < SR04_TICK_PERIOD) return;
    tick = 0;

    // ---------- ECHO 放电 (可选, 见上方说明) ----------
    SR04_ECHO = 0;
    delay_us(2);
    SR04_ECHO = 1;

    // ---------- 发 TRIG 脉冲 ≥10μs → 用 21μs 留余量 ----------
    SR04_TRIG = 1;
    delay_us(21);
    SR04_TRIG = 0;

    // ---------- 等 ECHO 变高 (最多 500 次循环 ≈ 500μs) ----------
    // 如果 500μs 内没变高 → 模块未连接或故障 → 放弃本次
    fast_wait = 500;
    while (fast_wait > 0 && !SR04_ECHO)
        fast_wait--;
    if (fast_wait == 0)
    {
        raw_mm = 0;
        return;
    }

    // ---------- ECHO 已变高，启动 Timer0 计时 ----------
    TH0 = 0;
    TL0 = 0;
    TF0 = 0;            // 清溢出标志
    sr04_timeout = 0;
    TR0 = 1;            // 开始计时

    // ---------- 等 ECHO 变低 (Timer0 溢出自动保护) ----------
    while (SR04_ECHO && !sr04_timeout);

    TR0 = 0;            // 停止 Timer0

    if (sr04_timeout)
    {
        raw_mm = 0;
        return;
    }

    // ---------- 读 Timer0 当前计数值 ----------
    ticks = (TH0 << 8) | TL0;

    // 脉宽 < 110 ticks (~120μs) → 距离 < ~2cm
    // HC-SR04 盲区约 2cm，此范围内数据不可靠，丢弃
    if (ticks < 110)
    {
        raw_mm = 0;
        return;
    }

    // ---------- ticks → mm 换算 ----------
    // 声速 340m/s → 往返 1mm = 5.8μs → 1 tick = 1.085μs
    // ticks_to_mm = ticks × 1.085 / 5.8 ≈ ticks × 17 / 92
    // 用 u32 中间值防溢出 (u16: max 65535 × 17 = 1,114,095 < 2^32)
    raw_mm = (u16)(((u32)ticks * 17UL) / 92UL);

    // 限制到 9999mm (≈10m), LCD 只显示 3 位
    if (raw_mm > 9999) raw_mm = 9999;

    // ---------- 喂入滑动平均窗口 ----------
    buf[idx] = raw_mm;
    idx++;
    if (idx >= SR04_WIN_SIZE) idx = 0;   // 环形
    if (fill < SR04_WIN_SIZE) fill++;     // 填充期计数
}

// ============================================================
// SR04_GetFiltered — 取滑动窗口平均值 (mm)
//
// 对 buf 中所有非零值求平均。
// 返回 0 的情况:
//   - 尚未有任何采样 (fill==0)
//   - 所有采样均为 0 (全部超时或太近)
//
// 窗大小 SR04_WIN_SIZE=3：
//   → 响应延时 ≈ 3×20ms = 60ms (填满窗口)
//   → 对距离突变会平滑过渡 (如从50cm→10cm需要3次采样体现)
// ============================================================
u16 SR04_GetFiltered(void)
{
    u32 sum = 0;
    u8  i, n = 0;

    if (fill == 0) return 0;

    for (i = 0; i < SR04_WIN_SIZE; i++)
    {
        if (buf[i] != 0)
        {
            sum += buf[i];
            n++;
        }
    }
    if (n == 0) return 0;

    return (u16)(sum / n);
}

// ============================================================
// SR04_GetDistance — 取最近一次原始值 (mm)
// 未滤波，直接返回 min(ticks*17/92, 9999)
// 0 = 本次无有效数据
// ============================================================
#if 0
u16 SR04_GetDistance(void)
{
    return raw_mm;
}
#endif
