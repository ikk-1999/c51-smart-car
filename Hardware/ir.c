/********************** HL-1 配套 NEC 红外遥控器 键码表 ************************
 *
 *  ┌──────────────────────────────┐
 *  │  数字键                      │
 *  │   0 = 0x16    5 = 0x1C       │
 *  │   1 = 0x0C    6 = 0x5A       │
 *  │   2 = 0x18    7 = 0x42       │
 *  │   3 = 0x5E    8 = 0x52       │
 *  │   4 = 0x08    9 = 0x4A       │
 *  ├──────────────────────────────┤
 *  │  功能键                      │
 *  │   电源   = 0x45              │
 *  │   菜单   = 0x46              │
 *  │   静音   = 0x47              │
 *  │   MODE   = 0x44              │
 *  │   前进 ▲ = 0x40              │
 *  │   后退 ▼ = 0x19              │
 *  │   左转 ◄ = 0x07              │
 *  │   返回   = 0x43              │
 *  │   暂停   = 0x15              │
 *  │   右转 ► = 0xD9              │
 *  │   OK     = 0x0D              │
 *  └──────────────────────────────┘
 *
 *  协议: NEC / TC9012
 *  地址码: 变化的 (不校验固定值，只校验反码正确性)
 *  校验: 地址+地址反码 + 命令+命令反码 双重校验
 *
 ******************************************************************/

#include "Hardware/ir.h"

// ============================================================
// 红外解码驱动实现
//
// 解码流程：
//   1. INT0 (P3.2) 下降沿触发 → 记录相邻两个下降沿间隔 (irdata[])
//   2. Timer0 模式2 自动重装，每个溢出 (~278μs) irtime++
//   3. 收集到 33 个边沿后 → Ircordpro() 解析成 4 字节
//   4. 校验通过 → new_cmd 标记 → Ir_GetCmd() 返回命令码
//
// 定时器配置：
//   Timer0 模式2, TH0=TL0=0 → 256 次机器周期 ≈ 278μs 溢出
//   33 × 278μs ≈ 9.2ms 最大测量间隔 (实际 NEC 最长 2.25ms)
// ============================================================

// ---------- 全局状态 (中断中读写) ----------
u8    irtime;           // 两个下降沿之间的滴答计数 (Timer0 中断)
idata u8 irdata[33];    // 33 个下降沿的时间间隔 (放 idata 节省 DATA)
u8    IRcord[4];        // 解码后的 4 字节: addr, ~addr, cmd, ~cmd
bit   irok;             // 33 个边沿收齐
bit   irpro_ok;         // 解码完成
u8    ir_cmd_last;      // 最近一次成功解码的命令码

// ---------- 内部函数声明 ----------
static void Ircordpro(void);

// ============================================================
// Ir_Init — 初始化红外接收
// ============================================================
void Ir_Init(void)
{
    // ---- Timer0 模式2：8位自动重装 ----
    TMOD &= 0xF0;
    TMOD |= 0x02;
    TH0 = 0x00;
    TL0 = 0x00;
    ET0 = 1;
    TR0 = 1;

    // ---- INT0：下降沿触发 ----
    IT0 = 1;
    EX0 = 1;

    // ---- 初始化变量 ----
    irtime  = 0;
    irok    = 0;
    irpro_ok = 0;
    ir_cmd_last = 0;
}

// ============================================================
// Ircordpro — 把 33 个边沿间隔解码成 4 字节 (NEC 协议)
//
// 解码逻辑：
//   33 个边沿顺序:
//     irdata[0]  → 引导码低电平 (≈9ms / 278μs ≈ 33 ticks)
//     irdata[1]  → 引导码高电平 (≈4.5ms / 278μs ≈ 16 ticks)
//     irdata[2..9]   → 地址码 (bit0→bit7, LSB first)
//     irdata[10..17] → 地址反码
//     irdata[18..25] → 命令码
//     irdata[26..32] → 命令反码 → 用完 32，实际共 33 个元素
//
//   每对相邻下降沿:
//     - 如果高电平 > IR_BIT_THRESHOLD (约 1.95ms) → bit = 1
//     - 如果高电平 ≤ 7 个 tick                        → bit = 0
//
//   移位解码（LSB first）:
//     value |= 0x80 (bit=1), 然后 right-shift
//     第 8 个 bit 不移位 → 刚好拼成 1 字节
//
// ⚠️ 本函数执行约 100μs，期间如果 INT0_ISR 触发并写 irdata，
//   会产生数据竞争。NEC 帧间距最小 ~108ms，实际碰撞概率低。
//   严格修复需在调用前执行 EX0=0 关 INT0 中断。
// ============================================================
static void Ircordpro(void)
{
    u8 i, j, k;
    u8 cord, value;

    value = 0;          // 显式初始化，防止栈上残留值污染解码
    k = 1;              // 从 irdata[1] 开始（跳过引导码低电平段）
    for (i = 0; i < 4; i++)      // 解码 4 个字节
    {
        for (j = 1; j <= 8; j++) // 每字节 8 位, LSB first
        {
            cord = irdata[k];
            if (cord > IR_BIT_THRESHOLD)
                value |= 0x80;   // 先在高位标记
            if (j < 8)
                value >>= 1;     // 右移，第 8 位不移
            k++;
        }
        IRcord[i] = value;
        value = 0;
    }
    irpro_ok = 1;     // 标记解码完成
}

// ============================================================
// Ir_GetCmd — 非阻塞读取最新命令码
//
// ⚠️ 数据竞争说明：
//   本函数在主循环中调用，Ircordpro() 读取 irdata[] 期间
//   INT0_ISR 可能同时写入同一数组。在 8051 上：
//     - 单字节读/写是原子的
//     - 但 Ircordpro 读 33 字节要 ~100μs，期间可能发生中断
//   → 可能读到新旧混合数据 → 校验会大概率失败（安全降级）
//
//   彻底的修复方案：
//     在调用 Ircordpro 和清零 irok 之间关 INT0（EX0=0）
//     但因为 NEC 帧间间隔最小 108ms，碰撞概率低，
//     当前容忍这种概率性丢帧是可以接受的。
//
//   同样地，以下代码存在 TOCTOU：
//     if (irok) { Ircordpro(); irok = 0; }
//   如果在 Ircordpro 执行期间 ISR 又设了 irok=1，
//   下一行的 irok=0 会覆盖 → 丢失一整帧。
//   用 EA=0 保护可以解决，但同样因为低概率先不动。
// ============================================================
u8 Ir_GetCmd(void)
{
    u8 cmd = 0;

    if (irok)
    {
        Ircordpro();
        irok = 0;
    }

    if (irpro_ok)
    {
        irpro_ok = 0;
        // 双重校验：地址反码 & 命令反码
        // 必须严格取反：IRcord[1] == ~IRcord[0], IRcord[3] == ~IRcord[2]
        if (IRcord[1] == (u8)(~IRcord[0]) &&
            IRcord[3] == (u8)(~IRcord[2]))
        {
            cmd = IRcord[2];
            ir_cmd_last = cmd;
        }
        // 校验失败 → cmd 保持为 0 → 安静丢弃, 等效于未收到
    }

    return cmd;
}

// ============================================================
// Ir_CmdToNum — 命令码转数字 (0-9)
//
// 如果 cmd 不是已知数字键 → 返回 0xFF (调用方配合 <=9 判断
// 来区分"不是数字"和"数字 0")。
// ============================================================
#if 0
u8 Ir_CmdToNum(u8 cmd)
{
    switch (cmd)
    {
        case IR_KEY_0: return 0;
        case IR_KEY_1: return 1;
        case IR_KEY_2: return 2;
        case IR_KEY_3: return 3;
        case IR_KEY_4: return 4;
        case IR_KEY_5: return 5;
        case IR_KEY_6: return 6;
        case IR_KEY_7: return 7;
        case IR_KEY_8: return 8;
        case IR_KEY_9: return 9;
        default:       return 0xFF;
    }
}
#endif
